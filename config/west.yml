## config/west.yml
```yaml
manifest:
  remotes:
    - name: zmkfirmware
      url-base: https://github.com/zmkfirmware
    - name: gagbo
      url-base: https://github.com/gagbo
  projects:
    - name: zmk
      remote: zmkfirmware
      revision: main
      import: app/west.yml
    - name: zmk-config-aekeynox
      remote: gagbo
      revision: feat/hrm-layers-bt-profiles
  self:
    path: config
```
